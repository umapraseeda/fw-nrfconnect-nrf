## samples/wifi/station/sample.yaml
```yaml
sample:
  description: Wi-Fi station sample application
  name: Wi-Fi station
tests:
  sample.nrf7002.station:
    sysbuild: true
    build_only: true
    integration_platforms:
      - nrf7002dk/nrf5340/cpuapp
    platform_allow: nrf7002dk/nrf5340/cpuapp
    tags:
      - ci_build
      - sysbuild
      - ci_samples_wifi
  sample.nrf7002.station.no_wifi_ready:
    sysbuild: true
    build_only: true
    extra_args: CONFIG_WIFI_READY_LIB=n
    integration_platforms:
      - nrf7002dk/nrf5340/cpuapp
    platform_allow: nrf7002dk/nrf5340/cpuapp
    tags:
      - ci_build
      - sysbuild
      - ci_samples_wifi
  sample.nrf7001.station:
    sysbuild: true
    build_only: true
    integration_platforms:
      - nrf7002dk/nrf5340/cpuapp/nrf7001
    platform_allow: nrf7002dk/nrf5340/cpuapp/nrf7001
    tags:
      - ci_build
      - sysbuild
      - ci_samples_wifi
    skip: true
  sample.nrf7002_eks.station:
    sysbuild: true
    build_only: true
    extra_args: SHIELD=nrf7002ek
    integration_platforms:
      - nrf5340dk/nrf5340/cpuapp
      - nrf52840dk/nrf52840
    platform_allow:
      - nrf5340dk/nrf5340/cpuapp
      - nrf52840dk/nrf52840
    extra_configs:
      - CONFIG_NET_TX_STACK_SIZE=3700
      - CONFIG_NET_RX_STACK_SIZE=3700
    tags:
      - ci_build
      - sysbuild
      - ci_samples_wifi
  sample.nrf7001_eks.station:
    sysbuild: true
    build_only: true
    extra_args: SHIELD=nrf7002ek_nrf7001
    integration_platforms:
      - nrf5340dk/nrf5340/cpuapp
      - nrf52840dk/nrf52840
    platform_allow:
      - nrf5340dk/nrf5340/cpuapp
      - nrf52840dk/nrf52840
    extra_configs:
      - CONFIG_NET_TX_STACK_SIZE=3700
      - CONFIG_NET_RX_STACK_SIZE=3700
    tags:
      - ci_build
      - sysbuild
      - ci_samples_wifi
  sample.nrf7002_eb.thingy53.station:
    sysbuild: true
    build_only: true
    extra_args: sta_SHIELD=nrf7002eb
    integration_platforms:
      - thingy53/nrf5340/cpuapp
    platform_allow: thingy53/nrf5340/cpuapp
    tags:
      - ci_build
      - sysbuild
      - ci_samples_wifi
  sample.nrf7002eb_interposer_p1.nrf7002eb.station:
    sysbuild: true
    build_only: true
    extra_args:
      - sta_SHIELD="nrf7002eb_interposer_p1;nrf7002eb"
      - sta_SNIPPET=nrf70-wifi
    integration_platforms:
      - nrf54h20dk/nrf54h20/cpuapp
      - nrf54l15dk/nrf54l15/cpuapp
    platform_allow:
      - nrf54h20dk/nrf54h20/cpuapp
      - nrf54l15dk/nrf54l15/cpuapp
    tags:
      - ci_build
      - sysbuild
      - ci_samples_wifi
  sample.nrf7002eb2.station:
    sysbuild: true
    build_only: true
    extra_args:
      - sta_SHIELD="nrf7002eb2"
      - SNIPPET=nrf70-wifi
    integration_platforms:
      - nrf54h20dk/nrf54h20/cpuapp
      - nrf54l15dk/nrf54l15/cpuapp
    platform_allow:
      - nrf54h20dk/nrf54h20/cpuapp
      - nrf54l15dk/nrf54l15/cpuapp
    tags:
      - ci_build
      - sysbuild
      - ci_samples_wifi
```

## subsys/net/lib/azure_fota/Kconfig
```kconfig
#
# Copyright (c) 2020 Nordic Semiconductor
#
# SPDX-License-Identifier: LicenseRef-BSD-5-Clause-Nordic
#

menuconfig AZURE_FOTA
	bool "Azure FOTA library [EXPERIMENTAL]"
	depends on FOTA_DOWNLOAD
	depends on CJSON_LIB

if AZURE_FOTA

config AZURE_FOTA_HOSTNAME_MAX_LEN
	int "Hostname buffer size"
	default 64

config AZURE_FOTA_FILE_PATH_MAX_LEN
	int "File path buffer size"
	default 64

config AZURE_FOTA_VERSION_MAX_LEN
	int "Version string buffer size"
	default 64

config AZURE_FOTA_APP_VERSION_AUTO
	bool "Automatically create application version"
	help
	  Automatically create app version string using the output from the
	  git command 'git describe'

config AZURE_FOTA_APP_VERSION
	string "Application version"
	default "0.0.0-dev"

config AZURE_FOTA_TLS
	bool "Use HTTPS for downloads"
	default y

config AZURE_FOTA_SEC_TAG
	int "TLS sec tag"
	default -1
	help
	  Security tag where TLS credentials are stored.
	  -1 indicates that TLS is not used.

config AZURE_FOTA_DOWNLOAD_PORT
	int "Port number"
	default 443 if AZURE_FOTA_TLS
	default 80

module=AZURE_FOTA
module-dep=LOG
module-str=Log level for Azure FOTA
module-help=Enables Azure FOTA log messages.
source "${ZEPHYR_BASE}/subsys/logging/Kconfig.template.log_config"

endif # AZURE_FOTA
```

## tests/subsys/bluetooth/mesh/light_ctrl/testcase.yaml
```yaml
tests:
  bluetooth.mesh.light_fixture:
    sysbuild: true
    platform_allow:
      - native_sim
    tags:
      - bluetooth
      - ci_build
      - sysbuild
    integration_platforms:
      - native_sim
```
